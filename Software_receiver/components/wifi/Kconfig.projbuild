## Software_receiver/components/wifi/Kconfig.projbuild
```kconfig
menu "WIFI"

    config SSID
        string "SSID"
        default "Iphone clement"
    config PASSWORD
        string "PASSWORD"
        default "azertyuiii"
endmenu
```

## Software_receiver/main/Kconfig.projbuild
```kconfig
menu "WIFI"

    config SSID
        string "SSID"
        default "AndroidAP8072"
    config PASSWORD
        string "PASSWORD"
        default "123456789"
endmenu
```
